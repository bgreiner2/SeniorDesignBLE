## LEDTest/boards/arm/nrf52810_custom/Kconfig.board
```kconfig
config BOARD_NRF52810_CUSTOM
    bool "Custom nRF52810 board"
    select SOC_NRF52810_QFAA
```

## NRF52810Setup/zephyr/boards/arm/ASL_Glove_nrf52810/ASL_Glove_nrf52810_defconfig
```kconfig
CONFIG_SOC_SERIES_NRF52X=y
CONFIG_SOC_NRF52810_QFAA=y
CONFIG_BOARD_ASL_GLOVE_NRF52810=y

CONFIG_GPIO=y
CONFIG_GPIO_AS_PINRESET=y

CONFIG_ARM_MPU=n
CONFIG_HW_STACK_PROTECTION=n

CONFIG_SERIAL=n
CONFIG_CONSOLE=n
CONFIG_UART_CONSOLE=n
CONFIG_PRINTK=n
CONFIG_LOG=n
CONFIG_BOOT_BANNER=n

CONFIG_PM=n
CONFIG_PM_DEVICE=n
```

## NRF52810Setup/zephyr/boards/arm/ASL_Glove_nrf52810/Kconfig.board
```kconfig
config BOARD_ASL_GLOVE_NRF52810
	bool "ASL Glove nRF52810"
	depends on SOC_NRF52810_QFAA
```

## NRF52810Setup/zephyr/boards/arm/ASL_Glove_nrf52810/Kconfig.defconfig
```kconfig
if BOARD_ASL_GLOVE_NRF52810

config BOARD
	default "ASL_Glove_nrf52810"

config BT_CTLR
	default BT

endif
```
